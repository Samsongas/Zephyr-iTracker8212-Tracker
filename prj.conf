## CMakeLists.txt
```
# Find Zephyr. This also loads Zephyr's build system.
cmake_minimum_required(VERSION 3.13.1)
find_package(Zephyr REQUIRED HINTS $ENV{ZEPHYR_BASE})
project(Zephyr-iTracker8212-Tracker)

# Add your source file to the "app" target. This must come after
# find_package(Zephyr) which defines the target.
target_sources(app PRIVATE 
	src/main.c
	src/bg-96-uart.c
	src/bg-96-gps.c
	src/bg-96-gprs.c
	src/http_post.c)
```

## prj.conf
```kconfig
CONFIG_CONSOLE=n
CONFIG_STDOUT_CONSOLE=n
CONFIG_UART_CONSOLE=n
CONFIG_CPLUSPLUS=n
CONFIG_GPIO=y
CONFIG_UART_INTERRUPT_DRIVEN=y
CONFIG_UART_CONSOLE_ON_DEV_NAME="UART_0"
```

## src/main.c
```c
#include "bg-96-uart.h"
#include "bg-96-gps.h"
#include "bg-96-gprs.h"
#include "http_post.h"

#define MAX_FAIL 10

/* Program parameters */
const char dest_ip[] = "0.0.0.0"; /* Destination IP */
const char dest_port[] = "8080"; /* Destination port */

void parse_position(char *buff)
{
	char message[BUFFER_MAX_HTTP_POST];
	if(strncmp((char)buff[0],"-",1) == 0)
		strncpy(message,buff,9);
	else
		strncpy(message,buff,8);
	strcpy(message,",");
	if(strncmp(buff[0],"-",1) == 0)
		strcpy(message,buff+9);
	else
		strcpy(message,buff+8);
	buff[0] = "\0";
	strcpy(buff,message);
}

int main(void){
	int ret;
	char buffer[BUFFER_MAX_HTTP_POST] = "";
	uint8_t cnt = 0;
	while(1){
		do {
			ret = uart_init();
		} while(ret != 0);
		do {
			ret = gps_init();
		} while(ret != 0);
		do {
			ret = gprs_init();
		} while(ret != 0);
		while(1) {
			cnt = 0;
			do {
				ret = get_location(buffer);
				cnt++;
			} while(ret != 0);
			if (cnt > MAX_FAIL)
				break;
			cnt = 0;
			parse_position(buffer);
			do {
				ret = gprs_send(&buffer,dest_ip,dest_port);
				cnt++;
			} while(ret != 0);
			if (cnt > MAX_FAIL)
				break;
		}
		// Dissconnect uart, gps and gprs?
	}
}
```

## src/bg-96-gprs.c
```c
#include "bg-96-uart.h"
#include "bg-96-gprs.h"
#include "http_post.h"
#include <string.h>
#include <zephyr.h>

/* AT Commands to be sent to BG96 */
const char GPRS_CFG_1[30] = "AT+QCFG=\"nbsibscramble\",0";
const char GPRS_CFG_2[30] = "AT+QCFG=\"band\",0,0,80,1";
const char GPRS_CFG_3[30] = "AT+QCFG=\"nwscanmode\",3,1";
const char GPRS_CFG_4[30] = "AT+QCFG=\"nwscanseq\",030201,1";
const char GPRS_CFG_5[30] = "AT+QCFG=\"iotopmode\",1,1";
const char GPRS_CFG_6[30] = "AT+QCFG=\"servicedomain\",1,1";
const char GPRS_GDCONT[30] = "AT+CGDCONT=1,\"IP\",\"internet\"";
const char GPRS_FUN[10] = "AT+CFUN=1";
const char GPRS_OPS[30] = "AT+COPS=1,2,\"22001\",0";
const char GPRS_IACT[20] = "AT+QIACT=1";
/* add ip and port as 79.114.83.116\",16666" */
const char GPRS_IOPEN[50] = "AT+QIOPEN=1,0,\"TCP\",\"";
const char GPRS_ICLOSE[30] = "AT+QICLOSE=0";
const char GPRS_ISENDEX[30] = "AT+QISENDEX=0,\"48656C6C6F\"";

/* BG96 responses */
const char GPRS_OK[] = "OK"; /* OK message */

/* GPS global variables */
char gprs_buff[BUFF_MAX_LENGTH] = "";


int uart_send_ok(const char *buff)
{
	int ret;
	/* Sending the received command */
	ret = uart_send(buff);
	/* return -1 if sending fails */
	if (ret == -1)
		return ret;
	/* Reading the response */
	ret = uart_read(gprs_buff);
	/* 0 if successful, -1 otherwise */
	if (ret == -1 || strcmp(gprs_buff, GPRS_OK) !=0)
		return -1;
	else
		return 0;
}


/*
 * Turns ON the GPRS on LTE mode
 * UART shall be turn on before calling this function.
 */
int gprs_init(void)
{
	int ret;
	/* Enable scrambling */
	ret = uart_send_ok(GPRS_CFG_1);
	if(ret != 0) return -1;
	k_sleep(K_MSEC(1000));
	/* Set baud */
	ret = uart_send_ok(GPRS_CFG_2);
	if(ret != 0) return -1;
	k_sleep(K_MSEC(1000));
	/* Set LTE mode */
	ret = uart_send_ok(GPRS_CFG_3);
	if(ret != 0) return -1;
	k_sleep(K_MSEC(1000));
	/* Set priority NB1 > M1 > 2G */
	ret = uart_send_ok(GPRS_CFG_4);
	if(ret != 0) return -1;
	k_sleep(K_MSEC(1000));
	/* Select CAT-NB1 */
	ret = uart_send_ok(GPRS_CFG_5);
	if(ret != 0) return -1;
	k_sleep(K_MSEC(1000));
	/* Set PS domain */
	ret = uart_send_ok(GPRS_CFG_6);
	if(ret != 0) return -1;
	k_sleep(K_MSEC(1000));
	/* Set APN provided */
	ret = uart_send_ok(GPRS_GDCONT);
	if(ret != 0) return -1;
	k_sleep(K_MSEC(1000));
	/* Set full functionality */
	ret = uart_send_ok(GPRS_FUN);
	if(ret != 0) return -1;
	k_sleep(K_MSEC(1000));
	/* Set MCC and MNC provided */
	ret = uart_send_ok(GPRS_OPS);
	if(ret != 0) return -1;
	k_sleep(K_MSEC(1000));
	/* Set MCC and MNC provided */
	ret = uart_send_ok(GPRS_OPS);
	if(ret != 0) return -1;
	k_sleep(K_MSEC(1000));
	/* Activate PDP context */
	ret = uart_send_ok(GPRS_OPS);
	if(ret != 0) return -1;
	k_sleep(K_MSEC(1000));
	return 0;
}

/*
 * Opens a TCP socket with the selected ip and port.
 * Sends contents of buffer.
 * Closes the connection.
 */
int gprs_send(char *ip, char *port, char *buff)
{
	int ret;
	/* Crafring of opening socket command */
	char command[BUFF_MAX_LENGTH];
	strcpy(command,GPRS_IOPEN);
	strcpy(command,ip);
	strcpy(command,"\",");
	strcpy(command,port);
	/* Open the socket */
	ret = uart_send_ok(GPRS_IOPEN);
	if(ret != 0) return -1;
	k_sleep(K_MSEC(1000));
	/* Crafring of message sending */
	char message[BUFF_MAX_LENGTH];
	strcpy(message,GPRS_ISENDEX);
	convert_to_post(buff);
	strcpy(message,buff);
	strcpy(message,"\"");
	/* Open the socket */
	ret = uart_send_ok(message);
	if(ret != 0) return -1;
	k_sleep(K_MSEC(1000));
	/* Close the socket */
	ret = uart_send_ok(GPRS_ICLOSE);
	if(ret != 0) return -1;
	return 0;
}
```

## src/bg-96-gprs.h
```c
#ifndef __BG_96_GPRS_H__
#define __BG_96_GPRS_H__

#include <zephyr.h>
#include <kernel.h>

int gprs_init(void);
int gprs_send(char *ip, char *port, char *buff);

#endif
```

## src/bg-96-gps.c
```c
#include "bg-96-uart.h"
#include "bg-96-gps.h"
#include <string.h>

/* AT Commands to be sent to BG96 */
const char GPS_ON[] = "AT+QGPS=1"; /* Turn on the GPS */
/* mode 2 <latitude>,<longitude> format: (-)dd.ddddd,(-)ddd.ddddd */
const char GPS_LOC[] = "AT+QGPSLOC=2"; /* Receive GPS location */
const char GPS_OFF[] = "AT+QGPSEND"; /* Turn off the GPS */

/* BG96 responses */
const char GPS_OK[] = "OK"; /* OK message */
const char GPS_POS[] = "+QGPSLOC:";	/* Receiving location. Starting string */

/* GPS global variables */
char gps_buff[BUFF_MAX_LENGTH] = "";

/*
 * Turns ON the GPS
 * UART shall be turn on before calling this function.
 */
int gps_init(void)
{
	int ret;
	/* Sending the command to turn ON */
	ret = uart_send(GPS_ON);
	/* return -1 if sending fails */
	if (ret == -1)
		return ret;
	/* Reading the response */
	ret = uart_read(gps_buff);
	/* 0 if successful, -1 otherwise */
	if (ret == -1 || strcmp(gps_buff, GPS_OK) !=0)
		return -1;
	else
		return 0;
}

/*
 * Gets location from the GPS
 * Writes the string returned from the BG-96 to a+
 * buffer passed as parameter.
 * UART shall be turn on before calling this function.
 */
int get_location(char *buff)
{
	int ret;
	/* Sending the command to turn ON */
	ret = uart_send(GPS_ON);
	/* return -1 if sending fails */
	if (ret == -1)
		return ret;
	/* Reading the response */
	ret = uart_read(gps_buff);
	/* return -1 if response is unexpected */
	char received[strlen(GPS_POS) + 1];
	strncpy(gps_buff, received, strlen(GPS_POS));
	received[strlen(GPS_POS)] = '\0';
	if(strcmp(received, GPS_POS) != 0)
		return -1;
	/* If the result has been as expected, copy the string to the buffer */
	strncpy(gps_buff,buff, strlen(gps_buff));
	return 0;
}
```

## src/bg-96-gps.cpp
```c
#include <errno.h>
#include <stddef.h>
#include <stdio.h>
#include <string>

#include <zephyr.h>
#include <arch/cpu.h>
#include <sys/byteorder.h>
#include <logging/log.h>
#include <sys/util.h>

#include <device.h>
#include <init.h>
#include <drivers/uart.h>

#define LOG_MODULE_NAME hci_uart
LOG_MODULE_REGISTER(LOG_MODULE_NAME);

static const struct device *hci_uart_dev;
static K_THREAD_STACK_DEFINE(tx_thread_stack, CONFIG_BT_HCI_TX_STACK_SIZE);
static struct k_thread tx_thread_data;
static K_FIFO_DEFINE(tx_queue);

/* RX in terms of bluetooth communication */
static K_FIFO_DEFINE(uart_tx_queue);

const String GPS-ON = "AT+QGPS=1" /* Turn on the GPS */
const String GPS-LOC = "AT+QGPSLOC?" /* Receive GPS location */
const String GPS-OFF = "AT+QGPSEND" /* Turn off the GPS */

/* Receiver states. */
const String GPS-OK = "OK" /* OK message */
const String GPS-POS = "+QGPSLOC:"	/* Receiving location. */

/* uart config parameters*/
static QT_UART_CONF_PARA uart1_conf =
{
	NULL,
	QT_UART_PORT_01,
	NULL,
	0,
	NULL,
	0,
	115200
};
```

## src/bg-96-gps.h
```c
#ifndef __BG_96_GPS_H__
#define __BG_96_GPS_H__

/*
 * Turns ON the GPS
 * UART shall be turn on before calling this function.
 */
int gps_init(void);
/*
 * Gets location from the GPS
 * Writes the string returned from the BG-96 to a+
 * buffer passed as parameter.
 * UART shall be turn on before calling this function.
 */
int get_location(char *buff);

#endif
```

## src/bg-96-uart.c
```c
#include "bg-96-uart.h"
#include <string.h>

/* UART configuration */
struct uart_config uart_cfg_check;
const struct uart_config uart_cfg = {
		.baudrate = 115200,
		.parity = UART_CFG_PARITY_NONE,
		.stop_bits = UART_CFG_STOP_BITS_1,
		.data_bits = UART_CFG_DATA_BITS_8,
		.flow_ctrl = UART_CFG_FLOW_CTRL_NONE
	};

/* 
 * Initialization of UART.
 * Must be run before any other function.
 */
int uart_init(void)
{
	const struct device *uart_dev = device_get_binding(UART_DEVICE_NAME);
	/* If the binding has not been possible */
	if (!uart_dev) {
		/* Return -1 */
		return -1;
	}

	/* Set device configuration using data in cfg */
	int ret = uart_configure(uart_dev, &uart_cfg);

	/* 0 if successful, -1 otherwise */
	return (ret == 0) ? 0 : -1;

}

/* 
 * Read from the UART until an end of line char is read.
 * Save data to buffer parameter.
 */
int uart_read(char *buff)
{
	const struct device *uart_dev = device_get_binding(UART_DEVICE_NAME);
	uint8_t recvData;
	int ret;
	uint8_t cnt = 0;
	do {
		ret = uart_fifo_read(uart_dev, &recvData, 1);
		if(ret != 1)
			break;
		buff[cnt] = recvData;
	}
	while ((recvData == '\n') || (recvData == '\r'));
	/* 0 if successful, -1 otherwise */
	return (ret == 0)? 0 : -1;
}

/* 
 * Write to the UART from buffer parameter.
 */
int uart_send(const char *buff)
{
	const struct device *uart_dev = device_get_binding(UART_DEVICE_NAME);
	int ret;
	ret = uart_fifo_fill(uart_dev, (uint8_t *)&buff, strlen(buff));
	/* 0 if successful, -1 otherwise */
	return (ret == strlen(buff))? 0 : -1;
}
```

## src/bg-96-uart.h
```c
#ifndef __BG_96_UART_H__
#define __BG_96_UART_H__

#include <drivers/uart.h>

#define UART_DEVICE_NAME "UART_0"
#define BUFF_MAX_LENGTH 50

/* 
 * Initialization of UART.
 * Must be run before any other function.
 */
int uart_init(void);
/* 
 * Read from the UART until an end of line char is read.
 * Save data to buffer parameter.
 */
int uart_read(char *buff);
/* 
 * Write to the UART from buffer parameter.
 */
int uart_send(const char *buff);

#endif
```

## src/http_post.c
```c
#include <stdlib.h>
#include <stdio.h>
#include <string.h>

#define BUFFER_MAX_HTTP_POST 150

const char http_post_header[BUFFER_MAX_HTTP_POST] = "POST /session HTTP/1.1\r\nHost: localhost:8000\r\nContent-Type: text/plain\r\nContent-Length:";

void convert_to_post(char *buff)
{
	int m_size = strlen(buff);
	char message[m_size+1];
	strcpy(message, buff);
	buff[0] = "\0";
	strcpy(buff, http_post_header);
	char m_len[3];
	m_len[0] = '0' + m_size/10;
	m_len[1] = '0' + m_size%10;
	m_len[2] = '\0';
	strcpy(buff, m_len);
	strcpy(buff, "\r\n\r\n");
	strcpy(buff, message);
}
```

## src/http_post.h
```c
#ifndef __HTTP_POST_H__
#define __HTTP_POST_H__


#include <stdlib.h>
#include <string.h>

#define BUFFER_MAX_HTTP_POST 150

void convert_to_post(char *buff);

#endif
```
